/* Copyright (c) 2020, The Linux Foundation. All rights reserved.
 *
 * This program is free software; you can redistribute it and/or modify
 * it under the terms of the GNU General Public License version 2 and
 * only version 2 as published by the Free Software Foundation.
 *
 * This program is distributed in the hope that it will be useful,
 * but WITHOUT ANY WARRANTY; without even the implied warranty of
 * MERCHANTABILITY or FITNESS FOR A PARTICULAR PURPOSE.  See the
 * GNU General Public License for more details.
 */

&pm8150l_pwm {
	status = "disabled";
};

&pm8150l_wled {
	qcom,string-cfg= <15>;// if use 2 string, the number is 3
	qcom,leds-per-string = <5>;
	status = "ok";
};

&red_led {
	status = "disabled";
};
